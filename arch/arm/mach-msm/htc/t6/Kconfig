## arch/arm/mach-msm/htc/t6/Kconfig
```kconfig
config BOARD_HEADER_FILE
	string "HTC board specific header file name"
	default ""

config MACH_T6_UL
	depends on ARCH_APQ8064
	select MACH_HTC
	bool "HTC One"
	help
	  Support for the HTC T6 device.

config MACH_T6_DWG
    depends on ARCH_APQ8064
	select MACH_HTC
    bool "APQ8064 T6_DWG"
	bool "HTC One"
    help
      Support for the HTC APQ8064 T6_DWG.    

config CABC_DIMMING_SWITCH
	bool "Enable panel CABC dimming switch"
	default y
	help
	  Enable CABC dimming switch.

config SRE_CONTROL
	bool "Enable panel SRE control"
	default y
	help
	  Enable SRE control.
```
